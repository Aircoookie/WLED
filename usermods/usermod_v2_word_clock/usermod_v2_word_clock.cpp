#include "wled.h"
#include "word_clock.h"

/*
 * Usermods allow you to add own functionality to WLED more easily
 * See: https://github.com/wled-dev/WLED/wiki/Add-own-functionality
 *
 * This usermod drives a word clock: one LED behind every letter of the front panel, plus up to 4 minute dots.
 * The front panel and all words are settings, so any layout and language can be used.
 * The defaults are the German 11x10 panel. See readme.md for the settings and for presets of other languages.
 */

// AI: below section was generated by an AI

// Defaults: the German 11x10 front panel with 4 minute dots after the letters (UTF-8, \xC3\x9C = Ü, \xC3\x96 = Ö)
static const char defaultLayout[] PROGMEM = "ESKISTAF\xC3\x9C" "NF|ZEHNZWANZIG|DREIVIERTEL|VORFUNKNACH|HALBAELF\xC3\x9C" "NF|"
                                            "EINSXAMZWEI|DREIPMJVIER|SECHSNLACHT|SIEBENZW\xC3\x96" "LF|ZEHNEUNKUHR|1234";
static const char defaultPrefix[] PROGMEM = "ES IST";
static const char defaultHours[] PROGMEM = "EINS,ZWEI,DREI#2,VIER#2,F\xC3\x9C" "NF#2,SECHS,SIEBEN,ACHT,NEUN,ZEHN#2,ELF,ZW\xC3\x96" "LF";
static const char defaultFullHours[] PROGMEM = "EIN";
static const char phrase00[] PROGMEM = "{H} UHR";
static const char phrase05[] PROGMEM = "F\xC3\x9C" "NF NACH {h}";
static const char phrase10[] PROGMEM = "ZEHN NACH {h}";
static const char phrase15[] PROGMEM = "VIERTEL {n}";
static const char phrase20[] PROGMEM = "ZWANZIG NACH {h}";
static const char phrase25[] PROGMEM = "F\xC3\x9C" "NF VOR HALB {n}";
static const char phrase30[] PROGMEM = "HALB {n}";
static const char phrase35[] PROGMEM = "F\xC3\x9C" "NF NACH HALB {n}";
static const char phrase40[] PROGMEM = "ZWANZIG VOR {n}";
static const char phrase45[] PROGMEM = "DREIVIERTEL {n}";
static const char phrase50[] PROGMEM = "ZEHN VOR {n}";
static const char phrase55[] PROGMEM = "F\xC3\x9C" "NF VOR {n}";
static const char* const defaultPhrases[WordClock::SLOTS] = {
  phrase00, phrase05, phrase10, phrase15, phrase20, phrase25, phrase30, phrase35, phrase40, phrase45, phrase50, phrase55
};
// replacements for :15 and :45 when the former "Norddeutsch" setting is found in the config
static const char phrase15Nord[] PROGMEM = "VIERTEL NACH {h}";
static const char phrase45Nord[] PROGMEM = "VIERTEL VOR {n}";
static constexpr uint8_t SLOT_QUARTER_PAST = 3;
static constexpr uint8_t SLOT_QUARTER_TO = 9;
static constexpr unsigned long UPDATE_INTERVAL = 5000; // ms between time checks

class WordClockUsermod : public Usermod {
  private:
    unsigned long lastTime = 0;
    int lastTimeMinutes = -1;

    bool usermodActive = false;
    bool displayItIs = false;
    int ledOffset = 100;
    bool meander = false;
    int brightnessActive = 255;  // scales the effect color of the lit letters
    int brightnessInactive = 0;  // scales the effect color of all other letters, 0 = off
    String layout = FPSTR(defaultLayout);
    String prefix = FPSTR(defaultPrefix);
    String hours = FPSTR(defaultHours);
    String fullHours = FPSTR(defaultFullHours);
    String phrases[WordClock::SLOTS];

    WordClock::Rows rows;
    uint8_t* ledMask = nullptr; // one byte per LED of the layout, 1 = on
    String configError;         // first problem found in the settings, shown on the info page

    static const char _name[];

    WordClock::Settings settings() const {
      WordClock::Settings s;
      s.layout = layout.c_str();
      s.prefix = prefix.c_str();
      s.hours = hours.c_str();
      s.fullHours = fullHours.c_str();
      for (uint8_t i = 0; i < WordClock::SLOTS; i++) s.phrases[i] = phrases[i].c_str();
      s.showPrefix = displayItIs;
      s.meander = meander;
      return s;
    }

    // Parses the layout, allocates the LED mask and checks every phrase with every hour.
    void applyConfig() {
      configError = "";
      lastTimeMinutes = -1; // redraw with the new settings
      if (ledMask) d_free(ledMask);
      ledMask = nullptr;
      if (!WordClock::parseRows(layout.c_str(), rows)) {
        configError = F("invalid layout");
        return;
      }
      const size_t maskSize = rows.start[rows.count];
      ledMask = static_cast<uint8_t*>(d_malloc(maskSize));
      if (!ledMask) {
        configError = F("out of memory");
        return;
      }
      memset(ledMask, 0, maskSize);
      const WordClock::Settings s = settings();
      WordClock::Composer check(s, rows, nullptr);
      for (uint8_t slot = 0; slot < WordClock::SLOTS; slot++) {
        for (uint8_t hour = 1; hour <= 12; hour++) {
          if (check.compose(hour, slot * 5)) continue;
          char msg[64];
          snprintf_P(msg, sizeof(msg), PSTR("%d:%02d: '%s' not found"), hour, slot * 5, check.missing);
          configError = msg;
          return;
        }
      }
    }

  public:
    WordClockUsermod() {
      for (uint8_t i = 0; i < WordClock::SLOTS; i++) phrases[i] = FPSTR(defaultPhrases[i]);
    }

    void setup() override {}

    void loop() override {
      if (!usermodActive || !ledMask) return;
      if (lastTimeMinutes >= 0 && millis() - lastTime < UPDATE_INTERVAL) return;
      lastTime = millis();

      if (toki.getTimeSource() == TOKI_TS_NONE) return; // the time is not known yet; stay dark until it is
      const int minutes = minute(localTime);
      if (minutes == lastTimeMinutes) return;
      lastTimeMinutes = minutes;

      const WordClock::Settings s = settings();
      WordClock::Composer(s, rows, ledMask).compose(hourFormat12(localTime), minutes);
    }

    void addToJsonInfo(JsonObject& root) override {
      JsonObject user = root["u"];
      if (user.isNull()) user = root.createNestedObject("u");
      JsonArray info = user.createNestedArray(F("Word clock"));
      if (configError.isEmpty()) info.add(F("settings OK"));
      else info.add(configError);
    }

    void addToConfig(JsonObject& root) override {
      JsonObject top = root.createNestedObject(FPSTR(_name));
      top[F("active")] = usermodActive;
      top[F("displayItIs")] = displayItIs;
      top[F("ledOffset")] = ledOffset;
      top[F("Meander wiring?")] = meander;
      top[F("brightnessActive")] = brightnessActive;
      top[F("brightnessInactive")] = brightnessInactive;
      top[F("layout")] = layout;
      top[F("prefix")] = prefix;
      top[F("hours")] = hours;
      top[F("fullHours")] = fullHours;
      for (uint8_t i = 0; i < WordClock::SLOTS; i++) {
        char key[10];
        snprintf_P(key, sizeof(key), PSTR("phrase%02d"), i * 5);
        top[key] = phrases[i];
      }
    }

    void appendConfigData() override {
      oappend(F("addInfo('WordClockUsermod:displayItIs',1,'show the prefix');"));
      oappend(F("addInfo('WordClockUsermod:ledOffset',1,'LEDs before the first letter');"));
      oappend(F("addInfo('WordClockUsermod:brightnessActive',1,'lit letters (0-255)');"));
      oappend(F("addInfo('WordClockUsermod:brightnessInactive',1,'other letters (0-255, 0 = off)');"));
      oappend(F("addInfo('WordClockUsermod:layout',1,'rows separated by |, 1-4 = minute dots');"));
      oappend(F("addInfo('WordClockUsermod:hours',1,'1 to 12, comma separated; WORD#2 = 2nd on panel');"));
      oappend(F("addInfo('WordClockUsermod:fullHours',1,'at the full hour, empty = hours');"));
      oappend(F("addInfo('WordClockUsermod:phrase00',1,'{h} hour, {n} next hour, {H} full hour');"));
    }

    bool readFromConfig(JsonObject& root) override {
      JsonObject top = root[FPSTR(_name)];

      bool configComplete = !top.isNull();

      configComplete &= getJsonValue(top[F("active")], usermodActive);
      configComplete &= getJsonValue(top[F("displayItIs")], displayItIs);
      configComplete &= getJsonValue(top[F("ledOffset")], ledOffset);
      configComplete &= getJsonValue(top[F("Meander wiring?")], meander);
      configComplete &= getJsonValue(top[F("brightnessActive")], brightnessActive);
      configComplete &= getJsonValue(top[F("brightnessInactive")], brightnessInactive);
      configComplete &= getJsonValue(top[F("layout")], layout);
      configComplete &= getJsonValue(top[F("prefix")], prefix);
      configComplete &= getJsonValue(top[F("hours")], hours);
      configComplete &= getJsonValue(top[F("fullHours")], fullHours);
      brightnessActive = constrain(brightnessActive, 0, 255);
      brightnessInactive = constrain(brightnessInactive, 0, 255);

      // configs from before the phrases were settings may still contain "Norddeutsch"
      bool nord = false;
      getJsonValue(top[F("Norddeutsch")], nord);

      for (uint8_t i = 0; i < WordClock::SLOTS; i++) {
        char key[10];
        snprintf_P(key, sizeof(key), PSTR("phrase%02d"), i * 5);
        if (getJsonValue(top[key], phrases[i])) continue;
        configComplete = false;
        if (nord && i == SLOT_QUARTER_PAST) phrases[i] = FPSTR(phrase15Nord);
        if (nord && i == SLOT_QUARTER_TO) phrases[i] = FPSTR(phrase45Nord);
      }

      applyConfig();
      return configComplete;
    }

    void handleOverlayDraw() override {
      if (!usermodActive || !ledMask) return;
      for (uint16_t x = 0; x < rows.start[rows.count]; x++) {
        const uint8_t amount = ledMask[x] ? brightnessActive : brightnessInactive;
        if (amount == 255) continue;
        const unsigned led = x + ledOffset;
        strip.setPixelColor(led, amount ? color_fade(strip.getPixelColor(led), amount) : RGBW32(0, 0, 0, 0));
      }
    }

    uint16_t getId() override {
      return USERMOD_ID_WORDCLOCK;
    }
};

const char WordClockUsermod::_name[] PROGMEM = "WordClockUsermod";

// AI: end

static WordClockUsermod usermod_v2_word_clock;
REGISTER_USERMOD(usermod_v2_word_clock);

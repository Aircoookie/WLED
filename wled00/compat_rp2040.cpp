#include "compat_rp2040.h"
#ifdef ARDUINO_ARCH_RP2040
#include <WiFi.h>

#ifndef MACSTR
  #define MACSTR "%02x:%02x:%02x:%02x:%02x:%02x"
#endif
#ifndef MAC2STR
  #define MAC2STR(a) (a)[0], (a)[1], (a)[2], (a)[3], (a)[4], (a)[5]
#endif

String wledBSSIDstr(int16_t networkItem) {
  uint8_t bssid[6] = {0,0,0,0,0,0};
  if (networkItem < 0) WiFi.BSSID(bssid);
  else                  WiFi.BSSID((uint8_t)networkItem, bssid);
  char buf[18];
  snprintf(buf, sizeof(buf), MACSTR, MAC2STR(bssid));
  return String(buf);
}

void     WledESPCompat::restart()      { rp2040.restart(); }
uint32_t WledESPCompat::getFreeHeap()  { return rp2040.getFreeHeap(); }

// ESP32/ESP8266's ESP.getFreeSketchSpace(): remaining room for a new firmware image.
// arduino-pico has no equivalent call, but the linker already gives us both ends of
// that region as symbols - __flash_binary_end (where this build's own image actually
// ends) and _FS_start (where the LittleFS partition begins, see platformio.ini's
// board_build.filesystem_size) - so this is a real measurement, not a guess.
extern "C" uint8_t _FS_start;
extern "C" uint8_t __flash_binary_end;
uint32_t WledESPCompat::getFreeSketchSpace() {
  return (uint32_t)&_FS_start - (uint32_t)&__flash_binary_end;
}

WledESPCompat ESP;

// AI: below section was generated by an AI
#include <hardware/watchdog.h>
#include <hardware/structs/watchdog.h>
#include <pico/time.h>

// scratch[0] layout: MAGIC in the top 16 bits, flag bits in 8-15, current WledCrumb in 0-7.
// The magic distinguishes our own values from power-on garbage (scratch is reset to 0 on POR).
static constexpr uint32_t CRUMB_MAGIC        = 0x57AD0000;
static constexpr uint32_t CRUMB_MAGIC_MASK   = 0xFFFF0000;
static constexpr uint32_t FLAG_HARDFAULT     = 0x0100; // set by isr_hardfault
static constexpr uint32_t FLAG_LOOP_STALLED  = 0x0200; // feeder timer saw loop() stop checking in
static constexpr uint32_t RP2040_WDT_MS        = 8000;  // hardware max is ~8.3s on RP2040
static constexpr uint32_t RP2040_LOOP_STALL_MS = 30000; // > CYW43's 15s blocking join + margin

static volatile uint32_t lastLoopBeat = 0;
static repeating_timer_t wdtFeeder;
static char resetReason[96] = "power-on/manual reset";

static const char* const crumbNames[] = {
  "none", "setup", "time", "connection", "notifications", "transitions",
  "usermods", "io", "dns", "presets", "strip", "housekeeping", "cfgwrite", "ws", "loopend"
};

void wledCrumb(WledCrumb c) {
  watchdog_hw->scratch[0] = (watchdog_hw->scratch[0] & 0xFF00) | CRUMB_MAGIC | c;
}

void wledWatchdogLoopBeat() {
  lastLoopBeat = millis();
  watchdog_hw->scratch[1] = lastLoopBeat;
}

// Runs in timer IRQ context every second. Stops feeding (=> reset ~8s later) once loop() has
// been silent too long. If an IRQ-level hang or a hard lockup stops this timer from running at
// all, the watchdog fires without FLAG_LOOP_STALLED - which is itself diagnostic.
static bool wdtFeederCb(repeating_timer_t*) {
  if (millis() - lastLoopBeat < RP2040_LOOP_STALL_MS) watchdog_update();
  else watchdog_hw->scratch[0] |= FLAG_LOOP_STALLED;
  return true;
}

void wledWatchdogBegin() {
  // decode why we booted *before* the scratch registers are reused
  uint32_t s0 = watchdog_hw->scratch[0];
  if (watchdog_caused_reboot() && (s0 & CRUMB_MAGIC_MASK) == CRUMB_MAGIC) {
    uint8_t crumb = s0 & 0xFF;
    const char* where = crumb < sizeof(crumbNames)/sizeof(crumbNames[0]) ? crumbNames[crumb] : "?";
    if (s0 & FLAG_HARDFAULT)
      snprintf(resetReason, sizeof(resetReason), "HardFault PC=0x%08lx LR=0x%08lx in %s",
               (unsigned long)watchdog_hw->scratch[2], (unsigned long)watchdog_hw->scratch[3], where);
    else
      snprintf(resetReason, sizeof(resetReason), "watchdog: %s in %s, last loop @%lus",
               (s0 & FLAG_LOOP_STALLED) ? "loop stalled" : "IRQ/lockup hang", where,
               (unsigned long)watchdog_hw->scratch[1] / 1000);
  } else if (watchdog_caused_reboot()) {
    strcpy(resetReason, "software reboot"); // rp2040.reboot()/restart() also go through the watchdog
  }
  watchdog_hw->scratch[0] = CRUMB_MAGIC | CRUMB_SETUP;
  lastLoopBeat = millis();
  watchdog_enable(RP2040_WDT_MS, true); // pause while a debugger halts the core
  add_repeating_timer_ms(1000, wdtFeederCb, nullptr, &wdtFeeder);
}

const char* wledResetReason() { return resetReason; }

// Cortex-M0+ HardFault: find the exception frame (MSP or PSP, per EXC_RETURN bit 2) and pass
// it to the C handler. Overrides pico-sdk's weak isr_hardfault (a breakpoint, i.e. a silent hang
// without a debugger attached).
extern "C" void __attribute__((used)) wledHardFaultC(uint32_t* frame) {
  watchdog_hw->scratch[2] = frame[6]; // stacked PC
  watchdog_hw->scratch[3] = frame[5]; // stacked LR
  watchdog_hw->scratch[0] |= CRUMB_MAGIC | FLAG_HARDFAULT;
  watchdog_reboot(0, 0, 0);
  while (true) {}
}
extern "C" void __attribute__((naked)) isr_hardfault(void) {
  __asm volatile(
    "movs r0, #4      \n"
    "mov  r1, lr      \n"
    "tst  r0, r1      \n"
    "beq  1f          \n"
    "mrs  r0, psp     \n"
    "b    2f          \n"
    "1: mrs r0, msp   \n"
    "2: ldr r1, =wledHardFaultC \n"
    "bx   r1          \n"
  );
}
// AI: end

#endif
